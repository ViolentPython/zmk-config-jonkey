## boards/shields/jonkey/Kconfig.shield
```kconfig
# Copyright (c) 2020 Ryan Cross
# SPDX-License-Identifier: MIT

config SHIELD_jonkey_LEFT
    def_bool $(shields_list_contains,jonkey_left)

config SHIELD_jonkey_RIGHT
    def_bool $(shields_list_contains,jonkey_right)
```

## boards/shields/jonkey/OLD/Kconfig.defconfig
```kconfig
if SHIELD_JONKEY_LEFT

config ZMK_KEYBOARD_NAME
    default "Jonkey"

config ZMK_SPLIT_ROLE_CENTRAL
    default y

endif # SHIELD_JONKEY_LEFT

if SHIELD_JONKEY_LEFT || SHIELD_JONKEY_RIGHT

config ZMK_SPLIT
    default y

endif # SHIELD_JONKEY_LEFT || SHIELD_JONKEY_RIGHT
```

## boards/shields/jonkey/OLD/Kconfig.shield
```kconfig
config SHIELD_JONKEY_LEFT
    def_bool $(shields_list_contains,jonkey_left)

config SHIELD_JONKEY_RIGHT
    def_bool $(shields_list_contains,jonkey_right)
```
